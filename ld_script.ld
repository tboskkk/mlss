/* GENERATED FILE. Do not hand-edit.
 * Edit tools/splits.yaml and run tools/gen_ldscript.py to regenerate. */
SECTIONS
{
    . = 0x2000000;

    ewram (NOLOAD) :
    ALIGN(0)
    {
    }

    . = 0x3000000;

    .bss (NOLOAD) :
    ALIGN(0)
    {
    }

    . = 0x8000000;

    .text :
    {
        build/asm/text08000000.o(.text);
        build/src/sub_8017E34.o(.text);
        build/asm/text08000000_p6.o(.text);
        build/src/sub_8018218.o(.text);
        build/asm/text08000000_p4.o(.text);
        build/src/sub_801859C.o(.text);
        build/asm/text08000000_p5.o(.text);
        build/src/sub_8018818.o(.text);
        build/asm/text08000000_p7.o(.text);
        build/src/reset_game_80189C4.o(.text);
        build/src/nullsub_17.o(.text);
        build/asm/text08000000_p2.o(.text);
        build/src/sub_8018AEC.o(.text);
        build/src/nullsub_16.o(.text);
        build/asm/text08000000_p3.o(.text);
        build/src/heap.o(.text);
        build/asm/heap.o(.text);
        build/src/sound.o(.text);
        build/asm/text08018E24.o(.text);
        build/src/sub_8019610.o(.text);
        build/asm/text08018E24_p2.o(.text);
        build/src/sub_80197C4.o(.text);
        build/asm/text08018E24_p3.o(.text);
        build/src/process.o(.text);
        build/asm/text08019CA4.o(.text);
        build/src/game_boy_player_logo.o(.text);
        build/asm/text0801A548.o(.text);
        build/src/sub_801A6B0.o(.text);
        build/asm/text0801A548_p37.o(.text);
        build/src/sub_801AA0C.o(.text);
        build/src/sub_801AA70.o(.text);
        build/asm/text0801A548_p40.o(.text);
        build/src/sub_801ADC0.o(.text);
        build/asm/text0801A548_p42.o(.text);
        build/src/sub_801AE3C.o(.text);
        build/asm/text0801A548_p43.o(.text);
        build/src/sub_801AEDC.o(.text);
        build/asm/text0801A548_p38.o(.text);
        build/src/sub_801B0AC.o(.text);
        build/asm/text0801A548_p23.o(.text);
        build/src/sub_801B748.o(.text);
        build/src/sub_801B75C.o(.text);
        build/asm/text0801A548_p5.o(.text);
        build/src/sub_801B820.o(.text);
        build/asm/text0801A548_p54.o(.text);
        build/src/sub_801B870.o(.text);
        build/src/time_update.o(.text);
        build/asm/text0801A548_p50.o(.text);
        build/src/sub_801BC40.o(.text);
        build/src/sub_801BC98.o(.text);
        build/asm/text0801A548_p29.o(.text);
        build/src/sub_801BE84.o(.text);
        build/asm/text0801A548_p51.o(.text);
        build/src/sub_801DB58.o(.text);
        build/asm/text0801A548_p55.o(.text);
        build/src/sub_801DC38.o(.text);
        build/asm/text0801A548_p30.o(.text);
        build/src/sub_801E3EC.o(.text);
        build/asm/text0801A548_p52.o(.text);
        build/src/sub_801EEBC.o(.text);
        build/asm/text0801A548_p53.o(.text);
        build/src/sub_80208E0.o(.text);
        build/asm/text0801A548_p12.o(.text);
        build/src/sub_8021AC8.o(.text);
        build/asm/text0801A548_p56.o(.text);
        build/src/sprite_heap_free.o(.text);
        build/src/sprite_heap_search.o(.text);
        build/src/sub_8021EA8.o(.text);
        build/asm/text0801A548_p24.o(.text);
        build/src/sub_802563C.o(.text);
        build/asm/text0801A548_p57.o(.text);
        build/src/sub_8025D24.o(.text);
        build/asm/text0801A548_p46.o(.text);
        build/src/sub_8025F28.o(.text);
        build/asm/text0801A548_p58.o(.text);
        build/src/sub_80262CC.o(.text);
        build/asm/text0801A548_p59.o(.text);
        build/src/sub_8027168.o(.text);
        build/asm/text0801A548_p60.o(.text);
        build/src/sub_80275F4.o(.text);
        build/asm/text0801A548_p61.o(.text);
        build/src/start_battle_8027AC4.o(.text);
        build/asm/text0801A548_p62.o(.text);
        build/src/sub_8028E4C.o(.text);
        build/src/sub_8028E70.o(.text);
        build/asm/text0801A548_p16.o(.text);
        build/src/sub_8028EE8.o(.text);
        build/asm/text0801A548_p6.o(.text);
        build/src/sub_8028F2C.o(.text);
        build/asm/text0801A548_p9.o(.text);
        build/src/sub_8029024.o(.text);
        build/asm/text0801A548_p3.o(.text);
        build/src/sub_8029060.o(.text);
        build/asm/text0801A548_p8.o(.text);
        build/src/sub_80290CC.o(.text);
        build/asm/text0801A548_p13.o(.text);
        build/src/sub_8029170.o(.text);
        build/asm/text0801A548_p63.o(.text);
        build/src/sub_8029380.o(.text);
        build/asm/text0801A548_p64.o(.text);
        build/src/sub_802973C.o(.text);
        build/asm/text0801A548_p65.o(.text);
        build/src/sub_8029804.o(.text);
        build/asm/text0801A548_p22.o(.text);
        build/src/sub_8029888.o(.text);
        build/asm/text0801A548_p21.o(.text);
        build/src/sub_8029910.o(.text);
        build/asm/text0801A548_p49.o(.text);
        build/src/sub_8029A0C.o(.text);
        build/asm/text0801A548_p66.o(.text);
        build/src/sub_802A608.o(.text);
        build/asm/text0801A548_p67.o(.text);
        build/src/sub_802C068.o(.text);
        build/asm/text0801A548_p68.o(.text);
        build/src/sub_802C428.o(.text);
        build/asm/text0801A548_p69.o(.text);
        build/src/sub_802C774.o(.text);
        build/asm/text0801A548_p70.o(.text);
        build/src/sub_802DA10.o(.text);
        build/asm/text0801A548_p71.o(.text);
        build/src/sub_802F834.o(.text);
        build/asm/text0801A548_p72.o(.text);
        build/src/sub_8030484.o(.text);
        build/asm/text0801A548_p73.o(.text);
        build/src/sub_80316FC.o(.text);
        build/asm/text0801A548_p32.o(.text);
        build/src/sub_8034FE8.o(.text);
        build/asm/text0801A548_p74.o(.text);
        build/src/sub_803AAE4.o(.text);
        build/asm/text0801A548_p75.o(.text);
        build/src/sub_803C424.o(.text);
        build/asm/text0801A548_p19.o(.text);
        build/src/sub_803C4D8.o(.text);
        build/src/sub_803C508.o(.text);
        build/asm/text0801A548_p25.o(.text);
        build/src/sub_803C720.o(.text);
        build/asm/text0801A548_p76.o(.text);
        build/src/sub_803D6D8.o(.text);
        build/asm/text0801A548_p77.o(.text);
        build/src/sub_803E9F0.o(.text);
        build/asm/text0801A548_p7.o(.text);
        build/src/init_fobj_803FEB8.o(.text);
        build/asm/text0801A548_p78.o(.text);
        build/src/sub_80401F0.o(.text);
        build/asm/text0801A548_p48.o(.text);
        build/src/sub_804034C.o(.text);
        build/asm/text0801A548_p36.o(.text);
        build/src/sub_8040C50.o(.text);
        build/asm/text0801A548_p79.o(.text);
        build/src/sub_8041A2C.o(.text);
        build/asm/text0801A548_p80.o(.text);
        build/src/sub_8046A10.o(.text);
        build/asm/text0801A548_p35.o(.text);
        build/src/sub_8046D18.o(.text);
        build/asm/text0801A548_p81.o(.text);
        build/src/sub_8047258.o(.text);
        build/asm/text0801A548_p33.o(.text);
        build/src/sub_8047364.o(.text);
        build/asm/text0801A548_p82.o(.text);
        build/src/sub_80475A0.o(.text);
        build/asm/text0801A548_p34.o(.text);
        build/src/sub_804776C.o(.text);
        build/asm/text0801A548_p15.o(.text);
        build/src/sub_8047804.o(.text);
        build/asm/text0801A548_p83.o(.text);
        build/src/sub_804790C.o(.text);
        build/asm/text0801A548_p17.o(.text);
        build/src/sub_804794C.o(.text);
        build/asm/text0801A548_p4.o(.text);
        build/src/sub_8047994.o(.text);
        build/asm/text0801A548_p10.o(.text);
        build/src/sub_8047A1C.o(.text);
        build/asm/text0801A548_p20.o(.text);
        build/src/sub_8047AF4.o(.text);
        build/asm/text0801A548_p11.o(.text);
        build/src/sub_8047B5C.o(.text);
        build/asm/text0801A548_p18.o(.text);
        build/src/sub_8047C18.o(.text);
        build/asm/text0801A548_p44.o(.text);
        build/src/sub_8047CE8.o(.text);
        build/asm/text0801A548_p45.o(.text);
        build/src/sub_8047EFC.o(.text);
        build/asm/text0801A548_p27.o(.text);
        build/src/sub_8047FDC.o(.text);
        build/src/sub_8048040.o(.text);
        build/asm/text0801A548_p28.o(.text);
        build/src/sub_80482E0.o(.text);
        build/asm/text0801A548_p84.o(.text);
        build/src/sub_8049C38.o(.text);
        build/asm/text0801A548_p85.o(.text);
        build/src/sub_804A124.o(.text);
        build/asm/text0801A548_p86.o(.text);
        build/src/sub_804B360.o(.text);
        build/asm/text0801A548_p87.o(.text);
        build/src/sub_804E6E0.o(.text);
        build/asm/text0801A548_p88.o(.text);
        build/src/sub_804FA94.o(.text);
        build/asm/text0801A548_p47.o(.text);
        build/src/sub_804FB14.o(.text);
        build/asm/text0801A548_p14.o(.text);
        build/src/sub_804FC30.o(.text);
        build/src/sub_804FC90.o(.text);
        build/asm/text0801A548_p39.o(.text);
        build/src/sub_80501EC.o(.text);
        build/asm/text0801A548_p89.o(.text);
        build/src/sub_80504BC.o(.text);
        build/asm/text0801A548_p90.o(.text);
        build/src/sub_80508A8.o(.text);
        build/asm/text0801A548_p91.o(.text);
        build/src/sub_8051330.o(.text);
        build/asm/text0801A548_p26.o(.text);
        build/src/sub_8051434.o(.text);
        build/asm/text0801A548_p41.o(.text);
        build/src/nullsub_19.o(.text);
        build/src/nullsub_18.o(.text);
        build/asm/text0801A548_p2.o(.text);
        build/src/sub_8051614.o(.text);
        build/asm/text0801A548_p31.o(.text);
        build/src/option_screens.o(.text);
        build/asm/option_screens.o(.text);
        build/src/sub_8052EFC.o(.text);
        build/asm/option_screens_p2.o(.text);
        build/src/opening_sequence.o(.text);
        build/asm/text080542C4.o(.text);
        build/src/title_screen.o(.text);
        build/asm/text08057568.o(.text);
        build/src/sub_8057D2C.o(.text);
        build/asm/text08057568_p371.o(.text);
        build/src/sub_8057FCC.o(.text);
        build/asm/text08057568_p372.o(.text);
        build/src/sub_80582DC.o(.text);
        build/asm/text08057568_p373.o(.text);
        build/src/sub_8058944.o(.text);
        build/asm/text08057568_p374.o(.text);
        build/src/sub_8059190.o(.text);
        build/asm/text08057568_p375.o(.text);
        build/src/sub_805980C.o(.text);
        build/asm/text08057568_p324.o(.text);
        build/src/sub_8059A8C.o(.text);
        build/asm/text08057568_p366.o(.text);
        build/src/sub_8059DDC.o(.text);
        build/src/sub_8059E5C.o(.text);
        build/src/sub_8059EC8.o(.text);
        build/src/sub_8059EF0.o(.text);
        build/asm/text08057568_p76.o(.text);
        build/src/sub_8059FE4.o(.text);
        build/src/stage_room_solidity_grid.o(.text);
        build/src/load_col_set_to_dest.o(.text);
        build/src/sub_805A0EC.o(.text);
        build/src/get_coldef_ptr_by_idx.o(.text);
        build/asm/text08057568_p41.o(.text);
        build/src/sub_805A1A8.o(.text);
        build/asm/text08057568_p376.o(.text);
        build/src/sub_805A7C0.o(.text);
        build/asm/text08057568_p377.o(.text);
        build/src/sub_805A900.o(.text);
        build/src/sub_805A954.o(.text);
        build/asm/text08057568_p20.o(.text);
        build/src/sub_805B074.o(.text);
        build/asm/text08057568_p378.o(.text);
        build/src/sub_805B590.o(.text);
        build/asm/text08057568_p379.o(.text);
        build/src/sub_805B9D4.o(.text);
        build/asm/text08057568_p380.o(.text);
        build/src/sub_805C6B8.o(.text);
        build/asm/text08057568_p381.o(.text);
        build/src/sub_805C8A4.o(.text);
        build/asm/text08057568_p382.o(.text);
        build/src/sub_805CCC0.o(.text);
        build/src/sub_805CCD8.o(.text);
        build/asm/text08057568_p21.o(.text);
        build/src/sub_805D0DC.o(.text);
        build/asm/text08057568_p383.o(.text);
        build/src/sub_805D3F8.o(.text);
        build/asm/text08057568_p384.o(.text);
        build/src/sub_805D8DC.o(.text);
        build/src/sub_805D914.o(.text);
        build/asm/text08057568_p159.o(.text);
        build/src/sub_805D9CC.o(.text);
        build/asm/text08057568_p385.o(.text);
        build/src/sub_805F508.o(.text);
        build/asm/text08057568_p325.o(.text);
        build/src/sub_805F5E4.o(.text);
        build/asm/text08057568_p129.o(.text);
        build/src/sub_805FF58.o(.text);
        build/asm/text08057568_p386.o(.text);
        build/src/sub_80604E0.o(.text);
        build/asm/text08057568_p130.o(.text);
        build/src/sub_80620C0.o(.text);
        build/asm/text08057568_p202.o(.text);
        build/src/sub_8062134.o(.text);
        build/asm/text08057568_p387.o(.text);
        build/src/sub_8063118.o(.text);
        build/asm/text08057568_p300.o(.text);
        build/src/sub_8063BF0.o(.text);
        build/asm/text08057568_p213.o(.text);
        build/src/sub_8064540.o(.text);
        build/asm/text08057568_p101.o(.text);
        build/src/sub_8064B88.o(.text);
        build/asm/text08057568_p266.o(.text);
        build/src/sub_8064DDC.o(.text);
        build/asm/text08057568_p388.o(.text);
        build/src/sub_8065B74.o(.text);
        build/asm/text08057568_p203.o(.text);
        build/src/sub_8065E2C.o(.text);
        build/src/sub_8065E4C.o(.text);
        build/asm/text08057568_p108.o(.text);
        build/src/sub_8066540.o(.text);
        build/asm/text08057568_p57.o(.text);
        build/src/sub_80665AC.o(.text);
        build/asm/text08057568_p389.o(.text);
        build/src/sub_80679FC.o(.text);
        build/asm/text08057568_p179.o(.text);
        build/src/sub_8067A4C.o(.text);
        build/asm/text08057568_p229.o(.text);
        build/src/sub_806814C.o(.text);
        build/asm/text08057568_p109.o(.text);
        build/src/sub_8068818.o(.text);
        build/asm/text08057568_p190.o(.text);
        build/src/sub_806A22C.o(.text);
        build/asm/text08057568_p131.o(.text);
        build/src/sub_806A2FC.o(.text);
        build/asm/text08057568_p390.o(.text);
        build/src/sub_806A77C.o(.text);
        build/asm/text08057568_p150.o(.text);
        build/src/sub_806A97C.o(.text);
        build/asm/text08057568_p204.o(.text);
        build/src/sub_806B56C.o(.text);
        build/asm/text08057568_p102.o(.text);
        build/src/sub_806B8F4.o(.text);
        build/asm/text08057568_p391.o(.text);
        build/src/sub_806C1A8.o(.text);
        build/asm/text08057568_p132.o(.text);
        build/src/sub_806D770.o(.text);
        build/asm/text08057568_p235.o(.text);
        build/src/sub_806E1B8.o(.text);
        build/asm/text08057568_p392.o(.text);
        build/src/sub_806E690.o(.text);
        build/asm/text08057568_p293.o(.text);
        build/src/sub_806E754.o(.text);
        build/src/sub_806E778.o(.text);
        build/src/nullsub_15.o(.text);
        build/asm/text08057568_p3.o(.text);
        build/src/sub_806E7CC.o(.text);
        build/asm/text08057568_p160.o(.text);
        build/src/sub_806E884.o(.text);
        build/asm/text08057568_p399.o(.text);
        build/src/sub_806F68C.o(.text);
        build/asm/text08057568_p400.o(.text);
        build/src/sub_806F7D8.o(.text);
        build/asm/text08057568_p401.o(.text);
        build/src/sub_8070510.o(.text);
        build/asm/text08057568_p161.o(.text);
        build/src/sub_80708F8.o(.text);
        build/asm/text08057568_p133.o(.text);
        build/src/sub_8070AE8.o(.text);
        build/asm/text08057568_p305.o(.text);
        build/src/sub_8070C84.o(.text);
        build/asm/text08057568_p22.o(.text);
        build/src/sub_8070DCC.o(.text);
        build/asm/text08057568_p402.o(.text);
        build/src/sub_8072150.o(.text);
        build/asm/text08057568_p403.o(.text);
        build/src/sub_8072350.o(.text);
        build/asm/text08057568_p134.o(.text);
        build/src/sub_8073E4C.o(.text);
        build/asm/text08057568_p249.o(.text);
        build/src/sub_807411C.o(.text);
        build/asm/text08057568_p135.o(.text);
        build/src/sub_807462C.o(.text);
        build/asm/text08057568_p122.o(.text);
        build/src/sub_8074688.o(.text);
        build/asm/text08057568_p136.o(.text);
        build/src/sub_80746EC.o(.text);
        build/asm/text08057568_p137.o(.text);
        build/src/sub_8074744.o(.text);
        build/asm/text08057568_p404.o(.text);
        build/src/sub_8077570.o(.text);
        build/asm/text08057568_p230.o(.text);
        build/src/sub_8079320.o(.text);
        build/asm/text08057568_p180.o(.text);
        build/src/sub_8079394.o(.text);
        build/asm/text08057568_p208.o(.text);
        build/src/sub_80793F4.o(.text);
        build/asm/text08057568_p91.o(.text);
        build/src/sub_80796B8.o(.text);
        build/asm/text08057568_p405.o(.text);
        build/src/sub_807C298.o(.text);
        build/asm/text08057568_p406.o(.text);
        build/src/sub_807C6D0.o(.text);
        build/asm/text08057568_p407.o(.text);
        build/src/sub_807D5E8.o(.text);
        build/asm/text08057568_p408.o(.text);
        build/src/sub_807F47C.o(.text);
        build/src/sub_807F4C4.o(.text);
        build/asm/text08057568_p224.o(.text);
        build/src/sub_807F53C.o(.text);
        build/asm/text08057568_p409.o(.text);
        build/src/sub_807F834.o(.text);
        build/asm/text08057568_p209.o(.text);
        build/src/sub_807FA50.o(.text);
        build/src/sub_807FA94.o(.text);
        build/asm/text08057568_p185.o(.text);
        build/src/sub_807FB34.o(.text);
        build/asm/text08057568_p410.o(.text);
        build/src/sub_807FC54.o(.text);
        build/asm/text08057568_p352.o(.text);
        build/src/sub_807FE40.o(.text);
        build/src/sub_807FE7C.o(.text);
        build/asm/text08057568_p215.o(.text);
        build/src/sub_807FF20.o(.text);
        build/asm/text08057568_p173.o(.text);
        build/src/sub_807FF98.o(.text);
        build/asm/text08057568_p123.o(.text);
        build/src/sub_8080064.o(.text);
        build/asm/text08057568_p411.o(.text);
        build/src/sub_80801A0.o(.text);
        build/asm/text08057568_p412.o(.text);
        build/src/sub_8081C54.o(.text);
        build/asm/text08057568_p174.o(.text);
        build/src/nullsub_3.o(.text);
        build/asm/text08057568_p5.o(.text);
        build/src/nullsub_4.o(.text);
        build/asm/text08057568_p6.o(.text);
        build/src/sub_8081FB0.o(.text);
        build/src/sub_8081FD4.o(.text);
        build/asm/text08057568_p367.o(.text);
        build/src/sub_8082158.o(.text);
        build/asm/text08057568_p294.o(.text);
        build/src/sub_808225C.o(.text);
        build/asm/text08057568_p153.o(.text);
        build/src/sub_8082A6C.o(.text);
        build/asm/text08057568_p436.o(.text);
        build/src/sub_8082B00.o(.text);
        build/asm/text08057568_p154.o(.text);
        build/src/sub_8082C20.o(.text);
        build/asm/text08057568_p216.o(.text);
        build/src/sub_8082CCC.o(.text);
        build/src/sub_8082D00.o(.text);
        build/src/sub_8082D24.o(.text);
        build/src/sub_8082D40.o(.text);
        build/asm/text08057568_p53.o(.text);
        build/src/sub_8083860.o(.text);
        build/asm/text08057568_p437.o(.text);
        build/src/sub_8083E78.o(.text);
        build/asm/text08057568_p44.o(.text);
        build/src/sub_8083EEC.o(.text);
        build/asm/text08057568_p308.o(.text);
        build/src/sub_80841B8.o(.text);
        build/asm/text08057568_p211.o(.text);
        build/src/sub_8084338.o(.text);
        build/asm/text08057568_p438.o(.text);
        build/src/sub_80846A4.o(.text);
        build/asm/text08057568_p607.o(.text);
        build/src/sub_8084E84.o(.text);
        build/asm/text08057568_p79.o(.text);
        build/src/sub_8084F28.o(.text);
        build/asm/text08057568_p439.o(.text);
        build/src/sub_808520C.o(.text);
        build/asm/text08057568_p608.o(.text);
        build/src/sub_808539C.o(.text);
        build/src/sub_8085440.o(.text);
        build/asm/text08057568_p504.o(.text);
        build/src/sub_8086150.o(.text);
        build/asm/text08057568_p609.o(.text);
        build/src/sub_8086960.o(.text);
        build/asm/text08057568_p505.o(.text);
        build/src/sub_8087038.o(.text);
        build/asm/text08057568_p278.o(.text);
        build/src/sub_808750C.o(.text);
        build/asm/text08057568_p95.o(.text);
        build/src/sub_80875B8.o(.text);
        build/asm/text08057568_p186.o(.text);
        build/src/sub_808761C.o(.text);
        build/asm/text08057568_p226.o(.text);
        build/src/sub_8087790.o(.text);
        build/asm/text08057568_p295.o(.text);
        build/src/sub_80877FC.o(.text);
        build/asm/text08057568_p290.o(.text);
        build/src/sub_8087968.o(.text);
        build/src/sub_8087A44.o(.text);
        build/asm/text08057568_p297.o(.text);
        build/src/sub_8087BA4.o(.text);
        build/asm/text08057568_p197.o(.text);
        build/src/sub_8087C4C.o(.text);
        build/asm/text08057568_p287.o(.text);
        build/src/sub_8088164.o(.text);
        build/asm/text08057568_p440.o(.text);
        build/src/sub_80883A0.o(.text);
        build/src/sub_80883F0.o(.text);
        build/asm/text08057568_p302.o(.text);
        build/src/sub_808843C.o(.text);
        build/asm/text08057568_p259.o(.text);
        build/src/sub_8088508.o(.text);
        build/asm/text08057568_p441.o(.text);
        build/src/sub_808862C.o(.text);
        build/asm/text08057568_p54.o(.text);
        build/src/sub_8089AB0.o(.text);
        build/asm/text08057568_p84.o(.text);
        build/src/sub_8089BD4.o(.text);
        build/asm/text08057568_p192.o(.text);
        build/src/sub_808C064.o(.text);
        build/asm/text08057568_p34.o(.text);
        build/src/sub_808C190.o(.text);
        build/asm/text08057568_p35.o(.text);
        build/src/sub_808DE44.o(.text);
        build/asm/text08057568_p442.o(.text);
        build/src/sub_808DFCC.o(.text);
        build/asm/text08057568_p506.o(.text);
        build/src/sub_808EBB8.o(.text);
        build/asm/text08057568_p507.o(.text);
        build/src/sub_808EC88.o(.text);
        build/asm/text08057568_p312.o(.text);
        build/src/sub_808FC84.o(.text);
        build/asm/text08057568_p313.o(.text);
        build/src/sub_8090460.o(.text);
        build/asm/text08057568_p443.o(.text);
        build/src/sub_8090608.o(.text);
        build/asm/text08057568_p508.o(.text);
        build/src/sub_8090748.o(.text);
        build/asm/text08057568_p329.o(.text);
        build/src/sub_80907CC.o(.text);
        build/asm/text08057568_p444.o(.text);
        build/src/sub_8090974.o(.text);
        build/asm/text08057568_p509.o(.text);
        build/src/sub_8090AB4.o(.text);
        build/asm/text08057568_p510.o(.text);
        build/src/sub_8090D70.o(.text);
        build/asm/text08057568_p511.o(.text);
        build/src/sub_8091AE0.o(.text);
        build/asm/text08057568_p512.o(.text);
        build/src/sub_8091B90.o(.text);
        build/asm/text08057568_p513.o(.text);
        build/src/sub_8091C44.o(.text);
        build/src/sub_8091C74.o(.text);
        build/asm/text08057568_p314.o(.text);
        build/src/sub_8092E04.o(.text);
        build/asm/text08057568_p315.o(.text);
        build/src/sub_8093E50.o(.text);
        build/asm/text08057568_p316.o(.text);
        build/src/sub_8095800.o(.text);
        build/asm/text08057568_p349.o(.text);
        build/src/sub_8098710.o(.text);
        build/asm/text08057568_p368.o(.text);
        build/src/sub_8099028.o(.text);
        build/asm/text08057568_p36.o(.text);
        build/src/sub_80993BC.o(.text);
        build/asm/text08057568_p37.o(.text);
        build/src/sub_809B3DC.o(.text);
        build/asm/text08057568_p445.o(.text);
        build/src/sub_809B738.o(.text);
        build/asm/text08057568_p514.o(.text);
        build/src/sub_809B920.o(.text);
        build/src/sub_809B960.o(.text);
        build/asm/text08057568_p350.o(.text);
        build/src/sub_809C954.o(.text);
        build/asm/text08057568_p38.o(.text);
        build/src/sub_809C9DC.o(.text);
        build/asm/text08057568_p141.o(.text);
        build/src/sub_809D268.o(.text);
        build/asm/text08057568_p39.o(.text);
        build/src/sub_809D9F4.o(.text);
        build/asm/text08057568_p446.o(.text);
        build/src/sub_809E410.o(.text);
        build/asm/text08057568_p187.o(.text);
        build/src/sub_809EB58.o(.text);
        build/asm/text08057568_p85.o(.text);
        build/src/sub_80A0304.o(.text);
        build/asm/text08057568_p447.o(.text);
        build/src/sub_80A0740.o(.text);
        build/src/sub_80A0788.o(.text);
        build/asm/text08057568_p515.o(.text);
        build/src/sub_80A1154.o(.text);
        build/asm/text08057568_p342.o(.text);
        build/src/sub_80A16A0.o(.text);
        build/asm/text08057568_p448.o(.text);
        build/src/sub_80A1990.o(.text);
        build/asm/text08057568_p516.o(.text);
        build/src/sub_80A1A90.o(.text);
        build/src/sub_80A1AB8.o(.text);
        build/asm/text08057568_p182.o(.text);
        build/src/sub_80A231C.o(.text);
        build/asm/text08057568_p343.o(.text);
        build/src/sub_80A2868.o(.text);
        build/asm/text08057568_p449.o(.text);
        build/src/sub_80A2B58.o(.text);
        build/asm/text08057568_p517.o(.text);
        build/src/sub_80A2C58.o(.text);
        build/src/sub_80A2C80.o(.text);
        build/asm/text08057568_p80.o(.text);
        build/src/sub_80A2F74.o(.text);
        build/asm/text08057568_p450.o(.text);
        build/src/sub_80A3324.o(.text);
        build/asm/text08057568_p357.o(.text);
        build/src/sub_80A3DF0.o(.text);
        build/asm/text08057568_p358.o(.text);
        build/src/sub_80A4210.o(.text);
        build/asm/text08057568_p359.o(.text);
        build/src/sub_80A53B0.o(.text);
        build/asm/text08057568_p360.o(.text);
        build/src/sub_80A5790.o(.text);
        build/asm/text08057568_p361.o(.text);
        build/src/sub_80A64C4.o(.text);
        build/asm/text08057568_p362.o(.text);
        build/src/sub_80A68AC.o(.text);
        build/asm/text08057568_p363.o(.text);
        build/src/sub_80A6FEC.o(.text);
        build/asm/text08057568_p451.o(.text);
        build/src/sub_80AC4AC.o(.text);
        build/src/sub_80AC4F8.o(.text);
        build/asm/text08057568_p227.o(.text);
        build/src/sub_80AC9C4.o(.text);
        build/asm/text08057568_p452.o(.text);
        build/src/sub_80B2570.o(.text);
        build/asm/text08057568_p610.o(.text);
        build/src/sub_80B30D8.o(.text);
        build/asm/text08057568_p518.o(.text);
        build/src/sub_80B35C8.o(.text);
        build/asm/text08057568_p351.o(.text);
        build/src/sub_80B992C.o(.text);
        build/asm/text08057568_p353.o(.text);
        build/src/sub_80BED0C.o(.text);
        build/asm/text08057568_p279.o(.text);
        build/src/sub_80C0FA4.o(.text);
        build/asm/text08057568_p453.o(.text);
        build/src/sub_80C3314.o(.text);
        build/asm/text08057568_p519.o(.text);
        build/src/sub_80C8684.o(.text);
        build/asm/text08057568_p520.o(.text);
        build/src/sub_80C8744.o(.text);
        build/asm/text08057568_p521.o(.text);
        build/src/sub_80C8A7C.o(.text);
        build/asm/text08057568_p354.o(.text);
        build/src/sub_80CD18C.o(.text);
        build/asm/text08057568_p355.o(.text);
        build/src/sub_80CFCCC.o(.text);
        build/asm/text08057568_p454.o(.text);
        build/src/sub_80D2D28.o(.text);
        build/asm/text08057568_p522.o(.text);
        build/src/sub_80D3224.o(.text);
        build/asm/text08057568_p356.o(.text);
        build/src/sub_80D6388.o(.text);
        build/asm/text08057568_p364.o(.text);
        build/src/sub_80D7410.o(.text);
        build/asm/text08057568_p365.o(.text);
        build/src/sub_80D9E9C.o(.text);
        build/asm/text08057568_p142.o(.text);
        build/src/sub_80D9F34.o(.text);
        build/asm/text08057568_p113.o(.text);
        build/src/sub_80DA0E0.o(.text);
        build/asm/text08057568_p143.o(.text);
        build/src/sub_80DA1EC.o(.text);
        build/asm/text08057568_p114.o(.text);
        build/src/sub_80DA324.o(.text);
        build/asm/text08057568_p115.o(.text);
        build/src/sub_80DA3E0.o(.text);
        build/asm/text08057568_p116.o(.text);
        build/src/sub_80DA45C.o(.text);
        build/asm/text08057568_p163.o(.text);
        build/src/sub_80DA97C.o(.text);
        build/asm/text08057568_p455.o(.text);
        build/src/sub_80DAAA4.o(.text);
        build/asm/text08057568_p523.o(.text);
        build/src/sub_80DABD0.o(.text);
        build/asm/text08057568_p524.o(.text);
        build/src/sub_80DAF30.o(.text);
        build/asm/text08057568_p525.o(.text);
        build/src/sub_80DB0FC.o(.text);
        build/asm/text08057568_p526.o(.text);
        build/src/sub_80DB184.o(.text);
        build/asm/text08057568_p527.o(.text);
        build/src/sub_80DB404.o(.text);
        build/asm/text08057568_p528.o(.text);
        build/src/sub_80DB54C.o(.text);
        build/asm/text08057568_p529.o(.text);
        build/src/sub_80DB694.o(.text);
        build/asm/text08057568_p530.o(.text);
        build/src/sub_80DB7B4.o(.text);
        build/src/sub_80DB844.o(.text);
        build/asm/text08057568_p531.o(.text);
        build/src/sub_80DBA98.o(.text);
        build/asm/text08057568_p532.o(.text);
        build/src/sub_80DBC3C.o(.text);
        build/asm/text08057568_p533.o(.text);
        build/src/sub_80DBD50.o(.text);
        build/asm/text08057568_p534.o(.text);
        build/src/sub_80DC0B4.o(.text);
        build/asm/text08057568_p535.o(.text);
        build/src/sub_80DC3A0.o(.text);
        build/asm/text08057568_p96.o(.text);
        build/src/sub_80DE948.o(.text);
        build/asm/text08057568_p97.o(.text);
        build/src/sub_80DEAC0.o(.text);
        build/asm/text08057568_p155.o(.text);
        build/src/sub_80DFB08.o(.text);
        build/asm/text08057568_p456.o(.text);
        build/src/sub_80E09DC.o(.text);
        build/src/sub_80E0BF8.o(.text);
        build/asm/text08057568_p536.o(.text);
        build/src/sub_80E12F8.o(.text);
        build/asm/text08057568_p537.o(.text);
        build/src/sub_80E13B4.o(.text);
        build/asm/text08057568_p310.o(.text);
        build/src/sub_80E163C.o(.text);
        build/asm/text08057568_p457.o(.text);
        build/src/sub_80E184C.o(.text);
        build/asm/text08057568_p231.o(.text);
        build/src/sub_80E1908.o(.text);
        build/asm/text08057568_p268.o(.text);
        build/src/sub_80E19CC.o(.text);
        build/asm/text08057568_p126.o(.text);
        build/src/sub_80E1AB0.o(.text);
        build/asm/text08057568_p458.o(.text);
        build/src/sub_80E2F40.o(.text);
        build/asm/text08057568_p611.o(.text);
        build/src/sub_80E3158.o(.text);
        build/asm/text08057568_p612.o(.text);
        build/src/sub_80E3CF4.o(.text);
        build/asm/text08057568_p538.o(.text);
        build/src/sub_80E3DA4.o(.text);
        build/asm/text08057568_p539.o(.text);
        build/src/sub_80E4084.o(.text);
        build/asm/text08057568_p613.o(.text);
        build/src/sub_80E4F98.o(.text);
        build/asm/text08057568_p540.o(.text);
        build/src/sub_80E5118.o(.text);
        build/asm/text08057568_p614.o(.text);
        build/src/sub_80E57FC.o(.text);
        build/asm/text08057568_p541.o(.text);
        build/src/sub_80E7B48.o(.text);
        build/asm/text08057568_p615.o(.text);
        build/src/sub_80E85C4.o(.text);
        build/asm/text08057568_p616.o(.text);
        build/src/sub_80E8D20.o(.text);
        build/asm/text08057568_p326.o(.text);
        build/src/sub_80E8E78.o(.text);
        build/asm/text08057568_p175.o(.text);
        build/src/sub_80E8F1C.o(.text);
        build/asm/text08057568_p117.o(.text);
        build/src/sub_80E92A8.o(.text);
        build/asm/text08057568_p15.o(.text);
        build/src/sub_80E9310.o(.text);
        build/asm/text08057568_p127.o(.text);
        build/src/sub_80E9414.o(.text);
        build/asm/text08057568_p281.o(.text);
        build/src/sub_80E9958.o(.text);
        build/src/sub_80E99E0.o(.text);
        build/src/sub_80E9A6C.o(.text);
        build/asm/text08057568_p271.o(.text);
        build/src/sub_80E9BD8.o(.text);
        build/asm/text08057568_p303.o(.text);
        build/src/sub_80E9C4C.o(.text);
        build/asm/text08057568_p459.o(.text);
        build/src/sub_80E9D04.o(.text);
        build/asm/text08057568_p542.o(.text);
        build/src/sub_80EA144.o(.text);
        build/src/sub_80EA358.o(.text);
        build/asm/text08057568_p543.o(.text);
        build/src/sub_80EA514.o(.text);
        build/asm/text08057568_p118.o(.text);
        build/src/sub_80EA670.o(.text);
        build/src/sub_80EA6D4.o(.text);
        build/src/sub_80EA778.o(.text);
        build/asm/text08057568_p164.o(.text);
        build/src/sub_80EA904.o(.text);
        build/src/sub_80EA91C.o(.text);
        build/asm/text08057568_p45.o(.text);
        build/src/sub_80EA9B8.o(.text);
        build/asm/text08057568_p336.o(.text);
        build/src/sub_80EAA5C.o(.text);
        build/asm/text08057568_p460.o(.text);
        build/src/sub_80EAB00.o(.text);
        build/asm/text08057568_p128.o(.text);
        build/src/sub_80EAD7C.o(.text);
        build/asm/text08057568_p104.o(.text);
        build/src/sub_80EAE30.o(.text);
        build/asm/text08057568_p461.o(.text);
        build/src/sub_80EAE9C.o(.text);
        build/asm/text08057568_p144.o(.text);
        build/src/sub_80EAFB4.o(.text);
        build/src/sub_80EB048.o(.text);
        build/asm/text08057568_p73.o(.text);
        build/src/script_cmd_wait_for_user_input.o(.text);
        build/asm/text08057568_p193.o(.text);
        build/src/script_cmd_wait_frames.o(.text);
        build/src/script_cmd_call.o(.text);
        build/asm/text08057568_p105.o(.text);
        build/src/script_cmd_end.o(.text);
        build/asm/text08057568_p46.o(.text);
        build/src/fld_script_execute_next_command.o(.text);
        build/asm/text08057568_p331.o(.text);
        build/src/sub_80ECB20.o(.text);
        build/asm/text08057568_p462.o(.text);
        build/src/sub_80ED17C.o(.text);
        build/asm/text08057568_p338.o(.text);
        build/src/sub_80ED4EC.o(.text);
        build/asm/text08057568_p344.o(.text);
        build/src/sub_80EDAB0.o(.text);
        build/asm/text08057568_p347.o(.text);
        build/src/sub_80EE594.o(.text);
        build/asm/text08057568_p463.o(.text);
        build/src/script_cmd_start_dialogue.o(.text);
        build/asm/text08057568_p617.o(.text);
        build/src/sub_80EEC18.o(.text);
        build/src/sub_80EECD0.o(.text);
        build/asm/text08057568_p317.o(.text);
        build/src/sub_80EEF54.o(.text);
        build/asm/text08057568_p327.o(.text);
        build/src/sub_80EF27C.o(.text);
        build/src/sub_80EF2EC.o(.text);
        build/asm/text08057568_p243.o(.text);
        build/src/sub_80F0000.o(.text);
        build/asm/text08057568_p464.o(.text);
        build/src/sub_80F01D4.o(.text);
        build/asm/text08057568_p544.o(.text);
        build/src/sub_80F032C.o(.text);
        build/asm/text08057568_p545.o(.text);
        build/src/script_enable_flag_2.o(.text);
        build/asm/text08057568_p47.o(.text);
        build/src/sub_80F0540.o(.text);
        build/asm/text08057568_p188.o(.text);
        build/src/sub_80F0724.o(.text);
        build/asm/text08057568_p298.o(.text);
        build/src/sub_80F087C.o(.text);
        build/src/sub_80F08A0.o(.text);
        build/asm/text08057568_p145.o(.text);
        build/src/sub_80F0AE0.o(.text);
        build/asm/text08057568_p198.o(.text);
        build/src/sub_80F0B4C.o(.text);
        build/src/sub_80F0B80.o(.text);
        build/asm/text08057568_p146.o(.text);
        build/src/sub_80F0CC4.o(.text);
        build/src/sub_80F0D38.o(.text);
        build/asm/text08057568_p254.o(.text);
        build/src/sub_80F0EEC.o(.text);
        build/asm/text08057568_p272.o(.text);
        build/src/sub_80F0FA0.o(.text);
        build/asm/text08057568_p232.o(.text);
        build/src/sub_80F10E0.o(.text);
        build/src/sub_80F110C.o(.text);
        build/asm/text08057568_p156.o(.text);
        build/src/sub_80F1A3C.o(.text);
        build/asm/text08057568_p309.o(.text);
        build/src/sub_80F1AA4.o(.text);
        build/src/sub_80F1AE4.o(.text);
        build/asm/text08057568_p25.o(.text);
        build/src/sub_80F1BA4.o(.text);
        build/src/sub_80F1C0C.o(.text);
        build/asm/text08057568_p165.o(.text);
        build/src/sub_80F1C7C.o(.text);
        build/src/sub_80F1CF8.o(.text);
        build/asm/text08057568_p265.o(.text);
        build/src/btl_script_execute_next_command.o(.text);
        build/asm/text08057568_p370.o(.text);
        build/src/sub_80F3808.o(.text);
        build/asm/text08057568_p285.o(.text);
        build/src/sub_80F39C8.o(.text);
        build/asm/text08057568_p282.o(.text);
        build/src/sub_80F4180.o(.text);
        build/asm/text08057568_p465.o(.text);
        build/src/sub_80F4DE4.o(.text);
        build/asm/text08057568_p618.o(.text);
        build/src/sub_80F5048.o(.text);
        build/src/sub_80F52B4.o(.text);
        build/asm/text08057568_p255.o(.text);
        build/src/sub_80F5924.o(.text);
        build/asm/text08057568_p339.o(.text);
        build/src/sub_80F5C90.o(.text);
        build/asm/text08057568_p466.o(.text);
        build/src/sub_80F60C4.o(.text);
        build/src/sub_80F6250.o(.text);
        build/asm/text08057568_p546.o(.text);
        build/src/sub_80F695C.o(.text);
        build/asm/text08057568_p547.o(.text);
        build/src/sub_80F6AC0.o(.text);
        build/asm/text08057568_p548.o(.text);
        build/src/sub_80F6EF8.o(.text);
        build/asm/text08057568_p280.o(.text);
        build/src/sub_80F7538.o(.text);
        build/src/sub_80F7590.o(.text);
        build/asm/text08057568_p147.o(.text);
        build/src/sub_80F76FC.o(.text);
        build/asm/text08057568_p258.o(.text);
        build/src/sub_80F7868.o(.text);
        build/asm/text08057568_p244.o(.text);
        build/src/sub_80F7ADC.o(.text);
        build/asm/text08057568_p304.o(.text);
        build/src/sub_80F7BF4.o(.text);
        build/asm/text08057568_p467.o(.text);
        build/src/sub_80F7CD0.o(.text);
        build/asm/text08057568_p549.o(.text);
        build/src/sub_80F7D3C.o(.text);
        build/src/sub_80F7D64.o(.text);
        build/asm/text08057568_p106.o(.text);
        build/src/sub_80F7E80.o(.text);
        build/asm/text08057568_p16.o(.text);
        build/src/sub_80F7EA4.o(.text);
        build/src/sub_80F7ED0.o(.text);
        build/asm/text08057568_p183.o(.text);
        build/src/sub_80F7F54.o(.text);
        build/asm/text08057568_p318.o(.text);
        build/src/sub_80F8008.o(.text);
        build/asm/text08057568_p250.o(.text);
        build/src/sub_80F80C4.o(.text);
        build/asm/text08057568_p233.o(.text);
        build/src/sub_80F8148.o(.text);
        build/asm/text08057568_p319.o(.text);
        build/src/sub_80F81D4.o(.text);
        build/src/sub_80F8254.o(.text);
        build/asm/text08057568_p166.o(.text);
        build/src/sub_80F82E8.o(.text);
        build/asm/text08057568_p217.o(.text);
        build/src/sub_80F85B4.o(.text);
        build/asm/text08057568_p468.o(.text);
        build/src/sub_80F86F0.o(.text);
        build/asm/text08057568_p332.o(.text);
        build/src/sub_80F8824.o(.text);
        build/asm/text08057568_p330.o(.text);
        build/src/sub_80F8984.o(.text);
        build/src/sub_80F8A08.o(.text);
        build/asm/text08057568_p148.o(.text);
        build/src/sub_80F8B34.o(.text);
        build/asm/text08057568_p320.o(.text);
        build/src/sub_80F8C60.o(.text);
        build/asm/text08057568_p189.o(.text);
        build/src/sub_80F8DA4.o(.text);
        build/asm/text08057568_p98.o(.text);
        build/src/sub_80FA104.o(.text);
        build/asm/text08057568_p469.o(.text);
        build/src/sub_80FA600.o(.text);
        build/src/sub_80FA6BC.o(.text);
        build/asm/text08057568_p550.o(.text);
        build/src/sub_80FA7A0.o(.text);
        build/src/sub_80FA7C4.o(.text);
        build/src/sub_80FA7E4.o(.text);
        build/asm/text08057568_p218.o(.text);
        build/src/sub_80FACA4.o(.text);
        build/asm/text08057568_p184.o(.text);
        build/src/sub_80FAD6C.o(.text);
        build/asm/text08057568_p470.o(.text);
        build/src/sub_80FAEC4.o(.text);
        build/src/sub_80FAEEC.o(.text);
        build/asm/text08057568_p55.o(.text);
        build/src/get_field_object_type.o(.text);
        build/src/get_field_object_count.o(.text);
        build/asm/text08057568_p86.o(.text);
        build/src/sub_80FB7BC.o(.text);
        build/src/sub_80FB7E0.o(.text);
        build/asm/text08057568_p56.o(.text);
        build/src/sub_80FBDE0.o(.text);
        build/src/sub_80FBE5C.o(.text);
        build/asm/text08057568_p167.o(.text);
        build/src/init_btl_process_80FC25C.o(.text);
        build/asm/text08057568_p471.o(.text);
        build/src/btl_80FC438.o(.text);
        build/asm/text08057568_p619.o(.text);
        build/src/btl_update_80FC8F4.o(.text);
        build/asm/text08057568_p551.o(.text);
        build/src/sub_80FD1AC.o(.text);
        build/asm/text08057568_p369.o(.text);
        build/src/sub_80FFD20.o(.text);
        build/asm/text08057568_p472.o(.text);
        build/src/sub_81015E4.o(.text);
        build/asm/text08057568_p620.o(.text);
        build/src/sub_81026DC.o(.text);
        build/asm/text08057568_p552.o(.text);
        build/src/sub_8103900.o(.text);
        build/asm/text08057568_p621.o(.text);
        build/src/sub_81059D8.o(.text);
        build/asm/text08057568_p622.o(.text);
        build/src/sub_8105D0C.o(.text);
        build/asm/text08057568_p623.o(.text);
        build/src/sub_8106214.o(.text);
        build/asm/text08057568_p553.o(.text);
        build/src/sub_81063A8.o(.text);
        build/asm/text08057568_p554.o(.text);
        build/src/sub_81064F8.o(.text);
        build/asm/text08057568_p555.o(.text);
        build/src/sub_81065D0.o(.text);
        build/asm/text08057568_p234.o(.text);
        build/src/sub_81066DC.o(.text);
        build/asm/text08057568_p473.o(.text);
        build/src/sub_81067D4.o(.text);
        build/src/sub_8106840.o(.text);
        build/asm/text08057568_p556.o(.text);
        build/src/sub_8106994.o(.text);
        build/src/sub_81069B4.o(.text);
        build/asm/text08057568_p119.o(.text);
        build/src/sub_8106A10.o(.text);
        build/asm/text08057568_p149.o(.text);
        build/src/sub_81070B8.o(.text);
        build/src/sub_8107118.o(.text);
        build/asm/text08057568_p228.o(.text);
        build/src/sub_8107BA4.o(.text);
        build/asm/text08057568_p474.o(.text);
        build/src/sub_8107F84.o(.text);
        build/asm/text08057568_p624.o(.text);
        build/src/sub_8108A44.o(.text);
        build/asm/text08057568_p625.o(.text);
        build/src/sub_8108B10.o(.text);
        build/asm/text08057568_p557.o(.text);
        build/src/sub_8108BE0.o(.text);
        build/src/sub_8108C38.o(.text);
        build/asm/text08057568_p194.o(.text);
        build/src/sub_8108CBC.o(.text);
        build/asm/text08057568_p74.o(.text);
        build/src/sub_810907C.o(.text);
        build/asm/text08057568_p475.o(.text);
        build/src/sub_810958C.o(.text);
        build/asm/text08057568_p558.o(.text);
        build/src/sub_8109CF4.o(.text);
        build/asm/text08057568_p626.o(.text);
        build/src/sub_8109E8C.o(.text);
        build/asm/text08057568_p559.o(.text);
        build/src/sub_810A984.o(.text);
        build/asm/text08057568_p560.o(.text);
        build/src/sub_810AC60.o(.text);
        build/asm/text08057568_p561.o(.text);
        build/src/sub_810B318.o(.text);
        build/asm/text08057568_p627.o(.text);
        build/src/sub_810B884.o(.text);
        build/asm/text08057568_p273.o(.text);
        build/src/sub_810CAD0.o(.text);
        build/asm/text08057568_p219.o(.text);
        build/src/sub_810CBDC.o(.text);
        build/asm/text08057568_p199.o(.text);
        build/src/sub_810CCB0.o(.text);
        build/asm/text08057568_p476.o(.text);
        build/src/sub_810CDFC.o(.text);
        build/asm/text08057568_p286.o(.text);
        build/src/sub_810D228.o(.text);
        build/src/sub_810D260.o(.text);
        build/asm/text08057568_p87.o(.text);
        build/src/sub_810D34C.o(.text);
        build/asm/text08057568_p299.o(.text);
        build/src/sub_810D424.o(.text);
        build/asm/text08057568_p477.o(.text);
        build/src/sub_810D4C4.o(.text);
        build/asm/text08057568_p99.o(.text);
        build/src/sub_810D5F4.o(.text);
        build/asm/text08057568_p195.o(.text);
        build/src/sub_810D694.o(.text);
        build/asm/text08057568_p200.o(.text);
        build/src/sub_810D70C.o(.text);
        build/asm/text08057568_p176.o(.text);
        build/src/sub_810FEF4.o(.text);
        build/asm/text08057568_p168.o(.text);
        build/src/sub_81109D0.o(.text);
        build/asm/text08057568_p157.o(.text);
        build/src/sub_8110ED8.o(.text);
        build/asm/text08057568_p478.o(.text);
        build/src/sub_811104C.o(.text);
        build/asm/text08057568_p562.o(.text);
        build/src/sub_8111100.o(.text);
        build/src/sub_8111174.o(.text);
        build/asm/text08057568_p563.o(.text);
        build/src/sub_8111214.o(.text);
        build/asm/text08057568_p564.o(.text);
        build/src/sub_81116C0.o(.text);
        build/asm/text08057568_p628.o(.text);
        build/src/sub_8112030.o(.text);
        build/src/sub_8112064.o(.text);
        build/asm/text08057568_p177.o(.text);
        build/src/sub_8112394.o(.text);
        build/asm/text08057568_p479.o(.text);
        build/src/sub_8112498.o(.text);
        build/asm/text08057568_p565.o(.text);
        build/src/sub_811254C.o(.text);
        build/asm/text08057568_p566.o(.text);
        build/src/sub_81126BC.o(.text);
        build/asm/text08057568_p567.o(.text);
        build/src/sub_81132AC.o(.text);
        build/asm/text08057568_p568.o(.text);
        build/src/sub_8113420.o(.text);
        build/asm/text08057568_p569.o(.text);
        build/src/sub_8113E44.o(.text);
        build/asm/text08057568_p570.o(.text);
        build/src/sub_8113F30.o(.text);
        build/asm/text08057568_p571.o(.text);
        build/src/sub_8114110.o(.text);
        build/asm/text08057568_p572.o(.text);
        build/src/sub_8114380.o(.text);
        build/asm/text08057568_p274.o(.text);
        build/src/sub_8114558.o(.text);
        build/asm/text08057568_p220.o(.text);
        build/src/sub_8114790.o(.text);
        build/asm/text08057568_p169.o(.text);
        build/src/sub_8114C1C.o(.text);
        build/asm/text08057568_p480.o(.text);
        build/src/sub_8116610.o(.text);
        build/asm/text08057568_p64.o(.text);
        build/src/sub_8116654.o(.text);
        build/asm/text08057568_p201.o(.text);
        build/src/sub_8116728.o(.text);
        build/asm/text08057568_p481.o(.text);
        build/src/sub_81169C8.o(.text);
        build/asm/text08057568_p88.o(.text);
        build/src/sub_8117778.o(.text);
        build/asm/text08057568_p482.o(.text);
        build/src/sub_8117C50.o(.text);
        build/asm/text08057568_p337.o(.text);
        build/src/sub_811E7E4.o(.text);
        build/asm/text08057568_p483.o(.text);
        build/src/sub_81218C8.o(.text);
        build/asm/text08057568_p573.o(.text);
        build/src/sub_81218E0.o(.text);
        build/asm/text08057568_p17.o(.text);
        build/src/sub_81230D0.o(.text);
        build/src/sub_81232E0.o(.text);
        build/asm/text08057568_p170.o(.text);
        build/src/sub_81233B4.o(.text);
        build/asm/text08057568_p484.o(.text);
        build/src/sub_81251DC.o(.text);
        build/asm/text08057568_p65.o(.text);
        build/src/tld_init_8127A94.o(.text);
        build/asm/text08057568_p333.o(.text);
        build/src/sub_8127E38.o(.text);
        build/asm/text08057568_p89.o(.text);
        build/src/sub_8127ECC.o(.text);
        build/asm/text08057568_p196.o(.text);
        build/src/sub_812A7A0.o(.text);
        build/asm/text08057568_p485.o(.text);
        build/src/sub_812F510.o(.text);
        build/asm/text08057568_p574.o(.text);
        build/src/sub_8132570.o(.text);
        build/asm/text08057568_p575.o(.text);
        build/src/sub_8132CE8.o(.text);
        build/asm/text08057568_p576.o(.text);
        build/src/sub_8132E34.o(.text);
        build/asm/text08057568_p577.o(.text);
        build/src/sub_8132EE0.o(.text);
        build/asm/text08057568_p578.o(.text);
        build/src/sub_813326C.o(.text);
        build/asm/text08057568_p579.o(.text);
        build/src/sub_81333D8.o(.text);
        build/asm/text08057568_p580.o(.text);
        build/src/sub_8133AE8.o(.text);
        build/asm/text08057568_p581.o(.text);
        build/src/sub_8133BC0.o(.text);
        build/asm/text08057568_p582.o(.text);
        build/src/sub_8133CF0.o(.text);
        build/asm/text08057568_p583.o(.text);
        build/src/sub_8134560.o(.text);
        build/asm/text08057568_p584.o(.text);
        build/src/sub_81346D0.o(.text);
        build/asm/text08057568_p171.o(.text);
        build/src/sub_8134A14.o(.text);
        build/asm/text08057568_p486.o(.text);
        build/src/sub_8134B24.o(.text);
        build/asm/text08057568_p100.o(.text);
        build/src/sub_8134B64.o(.text);
        build/asm/text08057568_p48.o(.text);
        build/src/sub_8134CAC.o(.text);
        build/asm/text08057568_p487.o(.text);
        build/src/sub_8135458.o(.text);
        build/asm/text08057568_p606.o(.text);
        build/src/sub_8135F20.o(.text);
        build/src/sub_8135F40.o(.text);
        build/asm/text08057568_p245.o(.text);
        build/src/sub_8136470.o(.text);
        build/src/sub_8136688.o(.text);
        build/asm/text08057568_p66.o(.text);
        build/src/sub_8136708.o(.text);
        build/asm/text08057568_p488.o(.text);
        build/src/sub_81367C0.o(.text);
        build/asm/text08057568_p334.o(.text);
        build/src/sub_8137CD8.o(.text);
        build/src/sub_8137E50.o(.text);
        build/asm/text08057568_p275.o(.text);
        build/src/sub_8138364.o(.text);
        build/asm/text08057568_p489.o(.text);
        build/src/sub_81385A8.o(.text);
        build/asm/text08057568_p585.o(.text);
        build/src/sub_8138F64.o(.text);
        build/src/sub_8138FA4.o(.text);
        build/src/sub_8138FD4.o(.text);
        build/asm/text08057568_p120.o(.text);
        build/src/sub_81390AC.o(.text);
        build/asm/text08057568_p490.o(.text);
        build/src/sub_8139200.o(.text);
        build/asm/text08057568_p246.o(.text);
        build/src/sub_81393D8.o(.text);
        build/asm/text08057568_p491.o(.text);
        build/src/sub_81394CC.o(.text);
        build/asm/text08057568_p586.o(.text);
        build/src/sub_81396A8.o(.text);
        build/asm/text08057568_p587.o(.text);
        build/src/sub_81398C4.o(.text);
        build/asm/text08057568_p588.o(.text);
        build/src/sub_8139970.o(.text);
        build/asm/text08057568_p263.o(.text);
        build/src/sub_8139AA0.o(.text);
        build/asm/text08057568_p492.o(.text);
        build/src/sub_8139E88.o(.text);
        build/asm/text08057568_p589.o(.text);
        build/src/sub_813B178.o(.text);
        build/asm/text08057568_p296.o(.text);
        build/src/sub_813B224.o(.text);
        build/asm/text08057568_p493.o(.text);
        build/src/sub_813B380.o(.text);
        build/asm/text08057568_p260.o(.text);
        build/src/sub_813B4C4.o(.text);
        build/asm/text08057568_p321.o(.text);
        build/src/sub_813B650.o(.text);
        build/asm/text08057568_p322.o(.text);
        build/src/sub_813B748.o(.text);
        build/asm/text08057568_p323.o(.text);
        build/src/sub_813B878.o(.text);
        build/asm/text08057568_p206.o(.text);
        build/src/sub_813B920.o(.text);
        build/src/sub_813B9B4.o(.text);
        build/asm/text08057568_p345.o(.text);
        build/src/sub_813BB60.o(.text);
        build/src/sub_813BC6C.o(.text);
        build/asm/text08057568_p121.o(.text);
        build/src/sub_813BF94.o(.text);
        build/asm/text08057568_p494.o(.text);
        build/src/sub_813C368.o(.text);
        build/asm/text08057568_p207.o(.text);
        build/src/sub_813C484.o(.text);
        build/asm/text08057568_p261.o(.text);
        build/src/sub_813DF58.o(.text);
        build/asm/text08057568_p212.o(.text);
        build/src/sub_813E618.o(.text);
        build/asm/text08057568_p495.o(.text);
        build/src/sub_813FB44.o(.text);
        build/asm/text08057568_p590.o(.text);
        build/src/sub_814260C.o(.text);
        build/asm/text08057568_p591.o(.text);
        build/src/sub_81426A4.o(.text);
        build/asm/text08057568_p592.o(.text);
        build/src/sub_8142760.o(.text);
        build/src/sub_81427AC.o(.text);
        build/asm/text08057568_p221.o(.text);
        build/src/nullsub_8.o(.text);
        build/asm/text08057568_p8.o(.text);
        build/src/sub_8142B4C.o(.text);
        build/asm/text08057568_p301.o(.text);
        build/src/sub_8142CF0.o(.text);
        build/asm/text08057568_p496.o(.text);
        build/src/sub_8142DB0.o(.text);
        build/asm/text08057568_p593.o(.text);
        build/src/sub_8142E6C.o(.text);
        build/asm/text08057568_p594.o(.text);
        build/src/sub_81433D0.o(.text);
        build/asm/text08057568_p595.o(.text);
        build/src/sub_8144238.o(.text);
        build/asm/text08057568_p222.o(.text);
        build/src/sub_8145A58.o(.text);
        build/asm/text08057568_p497.o(.text);
        build/src/sub_8145B00.o(.text);
        build/asm/text08057568_p596.o(.text);
        build/src/sub_8146DC8.o(.text);
        build/asm/text08057568_p251.o(.text);
        build/src/sub_814765C.o(.text);
        build/asm/text08057568_p498.o(.text);
        build/src/sub_8148B04.o(.text);
        build/asm/text08057568_p597.o(.text);
        build/src/sub_8148CA4.o(.text);
        build/asm/text08057568_p335.o(.text);
        build/src/sub_814B4C8.o(.text);
        build/asm/text08057568_p499.o(.text);
        build/src/sub_814B67C.o(.text);
        build/asm/text08057568_p598.o(.text);
        build/src/sub_814B7A4.o(.text);
        build/asm/text08057568_p348.o(.text);
        build/src/sub_814B848.o(.text);
        build/asm/text08057568_p283.o(.text);
        build/src/sub_814BEA8.o(.text);
        build/asm/text08057568_p288.o(.text);
        build/src/sub_814BFCC.o(.text);
        build/asm/text08057568_p289.o(.text);
        build/src/sub_814D838.o(.text);
        build/asm/text08057568_p500.o(.text);
        build/src/sub_814DB34.o(.text);
        build/asm/text08057568_p599.o(.text);
        build/src/sub_814DCFC.o(.text);
        build/asm/text08057568_p600.o(.text);
        build/src/sub_814F298.o(.text);
        build/asm/text08057568_p601.o(.text);
        build/src/sub_8150118.o(.text);
        build/asm/text08057568_p252.o(.text);
        build/src/sub_81501E4.o(.text);
        build/src/sub_8150244.o(.text);
        build/asm/text08057568_p223.o(.text);
        build/src/sub_815041C.o(.text);
        build/asm/text08057568_p501.o(.text);
        build/src/sub_8150590.o(.text);
        build/asm/text08057568_p602.o(.text);
        build/src/sub_81506B4.o(.text);
        build/asm/text08057568_p603.o(.text);
        build/src/sub_815071C.o(.text);
        build/asm/text08057568_p49.o(.text);
        build/src/sub_81507EC.o(.text);
        build/asm/text08057568_p158.o(.text);
        build/src/sub_8150B8C.o(.text);
        build/asm/text08057568_p502.o(.text);
        build/src/sub_8150DC8.o(.text);
        build/src/sub_8150DE8.o(.text);
        build/asm/text08057568_p19.o(.text);
        build/src/sub_8150E2C.o(.text);
        build/asm/text08057568_p50.o(.text);
        build/src/sub_8150EC0.o(.text);
        build/src/sub_8150EFC.o(.text);
        build/asm/text08057568_p67.o(.text);
        build/src/sub_8151758.o(.text);
        build/asm/text08057568_p394.o(.text);
        build/src/sub_8151CDC.o(.text);
        build/asm/text08057568_p435.o(.text);
        build/src/sub_81525C8.o(.text);
        build/src/sub_8152650.o(.text);
        build/asm/text08057568_p262.o(.text);
        build/src/sub_8153A10.o(.text);
        build/asm/text08057568_p503.o(.text);
        build/src/sub_8154950.o(.text);
        build/src/sub_8154AAC.o(.text);
        build/asm/text08057568_p284.o(.text);
        build/src/sub_8155684.o(.text);
        build/asm/text08057568_p604.o(.text);
        build/src/sub_81580F8.o(.text);
        build/src/sub_815817C.o(.text);
        build/asm/text08057568_p107.o(.text);
        build/src/sub_8158258.o(.text);
        build/src/sub_81582C4.o(.text);
        build/asm/text08057568_p26.o(.text);
        build/src/sub_8158308.o(.text);
        build/asm/text08057568_p27.o(.text);
        build/src/sub_815859C.o(.text);
        build/asm/text08057568_p605.o(.text);
        build/src/sub_8158790.o(.text);
        build/asm/text08057568_p276.o(.text);
        build/src/sub_8158A98.o(.text);
        build/asm/text08057568_p248.o(.text);
        build/src/sub_8158E10.o(.text);
        build/asm/text08057568_p28.o(.text);
        build/src/sub_8158F60.o(.text);
        build/asm/text08057568_p178.o(.text);
        build/src/sub_815928C.o(.text);
        build/asm/text08057568_p340.o(.text);
        build/src/nullsub_21.o(.text);
        build/asm/text08057568_p4.o(.text);
        build/src/sub_8159400.o(.text);
        build/asm/text08057568_p236.o(.text);
        build/src/sub_8159464.o(.text);
        build/asm/text08057568_p237.o(.text);
        build/src/sub_81595FC.o(.text);
        build/asm/text08057568_p264.o(.text);
        build/src/sub_8159904.o(.text);
        build/asm/text08057568_p29.o(.text);
        build/src/sub_8159974.o(.text);
        build/asm/text08057568_p58.o(.text);
        build/src/sub_8159A18.o(.text);
        build/asm/text08057568_p413.o(.text);
        build/src/sub_815A288.o(.text);
        build/asm/text08057568_p414.o(.text);
        build/src/sub_815B058.o(.text);
        build/asm/text08057568_p253.o(.text);
        build/src/sub_815D1DC.o(.text);
        build/asm/text08057568_p415.o(.text);
        build/src/sub_815DA48.o(.text);
        build/asm/text08057568_p416.o(.text);
        build/src/sub_815DC94.o(.text);
        build/asm/text08057568_p417.o(.text);
        build/src/sub_815E9EC.o(.text);
        build/src/sub_815EA08.o(.text);
        build/asm/text08057568_p92.o(.text);
        build/src/sub_815EC3C.o(.text);
        build/asm/text08057568_p59.o(.text);
        build/src/sub_815EC8C.o(.text);
        build/asm/text08057568_p30.o(.text);
        build/src/sub_815EDF4.o(.text);
        build/asm/text08057568_p418.o(.text);
        build/src/sub_815EFD8.o(.text);
        build/asm/text08057568_p269.o(.text);
        build/src/sub_815F2C4.o(.text);
        build/asm/text08057568_p238.o(.text);
        build/src/sub_815F7FC.o(.text);
        build/asm/text08057568_p239.o(.text);
        build/src/sub_815F85C.o(.text);
        build/asm/text08057568_p240.o(.text);
        build/src/sub_815F8BC.o(.text);
        build/asm/text08057568_p241.o(.text);
        build/src/sub_815FA3C.o(.text);
        build/asm/text08057568_p12.o(.text);
        build/src/sub_815FAA4.o(.text);
        build/src/sub_815FACC.o(.text);
        build/asm/text08057568_p93.o(.text);
        build/src/sub_81604A8.o(.text);
        build/asm/text08057568_p270.o(.text);
        build/src/get_surface_height_at_x.o(.text);
        build/src/sub_8160C18.o(.text);
        build/asm/text08057568_p419.o(.text);
        build/src/sub_8160E4C.o(.text);
        build/asm/text08057568_p110.o(.text);
        build/src/sub_8160EC4.o(.text);
        build/asm/text08057568_p78.o(.text);
        build/src/sub_8160F7C.o(.text);
        build/asm/text08057568_p420.o(.text);
        build/src/sub_816127C.o(.text);
        build/asm/text08057568_p138.o(.text);
        build/src/sub_816132C.o(.text);
        build/asm/text08057568_p13.o(.text);
        build/src/sub_816154C.o(.text);
        build/src/sub_816156C.o(.text);
        build/asm/text08057568_p60.o(.text);
        build/src/sub_816166C.o(.text);
        build/src/sub_816168C.o(.text);
        build/asm/text08057568_p31.o(.text);
        build/src/sub_81617F4.o(.text);
        build/src/sub_8161814.o(.text);
        build/asm/text08057568_p267.o(.text);
        build/src/sub_8161954.o(.text);
        build/asm/text08057568_p139.o(.text);
        build/src/sub_8161A38.o(.text);
        build/asm/text08057568_p421.o(.text);
        build/src/sub_8161C08.o(.text);
        build/asm/text08057568_p422.o(.text);
        build/src/sub_8161C9C.o(.text);
        build/asm/text08057568_p292.o(.text);
        build/src/sub_8162968.o(.text);
        build/asm/text08057568_p423.o(.text);
        build/src/sub_8163110.o(.text);
        build/asm/text08057568_p151.o(.text);
        build/src/sub_81631DC.o(.text);
        build/asm/text08057568_p82.o(.text);
        build/src/sub_8163238.o(.text);
        build/src/sub_8163264.o(.text);
        build/asm/text08057568_p111.o(.text);
        build/src/sub_81632C8.o(.text);
        build/src/sub_81632EC.o(.text);
        build/asm/text08057568_p124.o(.text);
        build/src/sub_8163320.o(.text);
        build/asm/text08057568_p42.o(.text);
        build/src/sub_8163394.o(.text);
        build/asm/text08057568_p181.o(.text);
        build/src/sub_816359C.o(.text);
        build/asm/text08057568_p277.o(.text);
        build/src/sub_8163650.o(.text);
        build/asm/text08057568_p152.o(.text);
        build/src/sub_8163748.o(.text);
        build/asm/text08057568_p83.o(.text);
        build/src/sub_8163864.o(.text);
        build/asm/text08057568_p424.o(.text);
        build/src/sub_81638B0.o(.text);
        build/asm/text08057568_p68.o(.text);
        build/src/sub_816391C.o(.text);
        build/asm/text08057568_p125.o(.text);
        build/src/sub_81639D4.o(.text);
        build/asm/text08057568_p43.o(.text);
        build/src/sub_81639F8.o(.text);
        build/asm/text08057568_p61.o(.text);
        build/src/sub_8163A64.o(.text);
        build/asm/text08057568_p23.o(.text);
        build/src/sub_8163B5C.o(.text);
        build/asm/text08057568_p14.o(.text);
        build/src/sub_8163BA0.o(.text);
        build/src/sub_8163BB8.o(.text);
        build/asm/text08057568_p32.o(.text);
        build/src/sub_8163D10.o(.text);
        build/src/sub_8163D4C.o(.text);
        build/asm/text08057568_p242.o(.text);
        build/src/sub_8163DB8.o(.text);
        build/asm/text08057568_p425.o(.text);
        build/src/sub_8163E50.o(.text);
        build/src/sub_8163EE4.o(.text);
        build/src/sub_8163F6C.o(.text);
        build/src/sub_8163FA8.o(.text);
        build/src/sub_8163FB8.o(.text);
        build/asm/text08057568_p51.o(.text);
        build/src/sub_8164FA4.o(.text);
        build/asm/text08057568_p426.o(.text);
        build/src/sub_8165250.o(.text);
        build/asm/text08057568_p162.o(.text);
        build/src/sub_8165420.o(.text);
        build/src/sub_816544C.o(.text);
        build/asm/text08057568_p24.o(.text);
        build/src/sub_8167DF8.o(.text);
        build/asm/text08057568_p140.o(.text);
        build/src/sub_8167E9C.o(.text);
        build/asm/text08057568_p341.o(.text);
        build/src/sub_8167F30.o(.text);
        build/asm/text08057568_p62.o(.text);
        build/src/sub_81682CC.o(.text);
        build/asm/text08057568_p427.o(.text);
        build/src/sub_816AFDC.o(.text);
        build/src/sub_816AFF0.o(.text);
        build/asm/text08057568_p63.o(.text);
        build/src/sub_816B0E0.o(.text);
        build/asm/text08057568_p428.o(.text);
        build/src/sub_816B384.o(.text);
        build/asm/text08057568_p225.o(.text);
        build/src/sub_816BEC4.o(.text);
        build/asm/text08057568_p429.o(.text);
        build/src/sub_816D734.o(.text);
        build/asm/text08057568_p311.o(.text);
        build/src/sub_816D814.o(.text);
        build/asm/text08057568_p94.o(.text);
        build/src/sub_816DB10.o(.text);
        build/asm/text08057568_p430.o(.text);
        build/src/sub_816F8D8.o(.text);
        build/asm/text08057568_p431.o(.text);
        build/src/sub_816FBD0.o(.text);
        build/asm/text08057568_p432.o(.text);
        build/src/sub_8171B44.o(.text);
        build/asm/text08057568_p112.o(.text);
        build/src/sub_8171F44.o(.text);
        build/asm/text08057568_p69.o(.text);
        build/src/sub_8171FF8.o(.text);
        build/asm/text08057568_p433.o(.text);
        build/src/sub_8199470.o(.text);
        build/asm/text08057568_p52.o(.text);
        build/src/sub_8199624.o(.text);
        build/asm/text08057568_p434.o(.text);
        build/src/sub_8199D48.o(.text);
        build/asm/text08057568_p70.o(.text);
        build/src/sub_8199F24.o(.text);
        build/asm/text08057568_p33.o(.text);
        build/src/sub_819A694.o(.text);
        build/asm/text08057568_p71.o(.text);
        build/src/sub_819A6EC.o(.text);
        build/src/sub_819A718.o(.text);
        build/asm/text08057568_p72.o(.text);
        build/src/sub_819A770.o(.text);
        build/asm/text08057568_p210.o(.text);
        build/src/sub_819A8EC.o(.text);
        build/asm/text08057568_p306.o(.text);
        build/src/sub_819A9B4.o(.text);
        build/asm/text08057568_p191.o(.text);
        build/src/sub_819AB78.o(.text);
        build/asm/text08057568_p307.o(.text);
        build/src/sub_819AF88.o(.text);
        build/src/nullsub_7.o(.text);
        build/asm/text08057568_p2.o(.text);
        build/src/sub_819B040.o(.text);
        build/asm/text08057568_p205.o(.text);
        build/src/sub_819B0AC.o(.text);
        build/src/sub_819B0F8.o(.text);
        build/asm/text08057568_p77.o(.text);
        build/src/sub_819B19C.o(.text);
        build/asm/text08057568_p90.o(.text);
        build/src/sub_819B22C.o(.text);
        build/asm/text08057568_p393.o(.text);
        build/src/sub_819B31C.o(.text);
        build/src/sub_819B418.o(.text);
        build/asm/text08057568_p214.o(.text);
        build/src/sub_81DA690.o(.text);
        build/asm/text08057568_p10.o(.text);
        build/src/sub_81DA6A8.o(.text);
        build/asm/text08057568_p11.o(.text);
        build/src/sub_81DA72C.o(.text);
        build/asm/text08057568_p256.o(.text);
        build/src/__divsi3.o(.text);
        build/src/nullsub_1.o(.text);
        build/asm/text08057568_p328.o(.text);
        build/src/__udivsi3.o(.text);
        build/asm/text08057568_p395.o(.text);
        build/src/sub_81DAF6C.o(.text);
        build/asm/text08057568_p396.o(.text);
        build/src/sub_81DB964.o(.text);
        build/asm/text08057568_p397.o(.text);
        build/src/sub_81DBBA0.o(.text);
        build/asm/text08057568_p291.o(.text);
        build/src/sub_81DC3F0.o(.text);
        build/asm/text08057568_p398.o(.text);
        build/src/sub_81DC43C.o(.text);
        build/src/sub_81DC49C.o(.text);
        build/asm/text08057568_p257.o(.text);
        build/src/_negdi2.o(.text);
        build/asm/text08057568_p103.o(.text);
        build/src/isatty.o(.text);
        build/src/alarm.o(.text);
        build/asm/text08057568_p9.o(.text);
        build/src/memset.o(.text);
        build/src/nullsub_5.o(.text);
        build/asm/text08057568_p7.o(.text);
        build/src/sub_81DCE7C.o(.text);
        build/asm/text08057568_p172.o(.text);
        build/src/sub_81DCF58.o(.text);
        build/asm/text08057568_p81.o(.text);
        build/src/sub_81DD2E0.o(.text);
        build/asm/text08057568_p40.o(.text);
        build/src/sub_81DD5B0.o(.text);
        build/asm/text08057568_p247.o(.text);
        build/src/sub_81DD670.o(.text);
        build/asm/text08057568_p346.o(.text);
        build/src/sub_81DD69C.o(.text);
        build/asm/text08057568_p75.o(.text);
        build/src/sub_81DD76C.o(.text);
        build/asm/text08057568_p18.o(.text);

        build/asm/rodata081DD790.o(.rodata);
        build/src/title_screen.o(.rodata);
        build/asm/rodata081E2764.o(.rodata);

        build/asm/mariobros.o(.text);
    }

    /* DWARF 2 sections */
    .debug_aranges  0 : { *(.debug_aranges) }
    .debug_pubnames 0 : { *(.debug_pubnames) }
    .debug_info     0 : { *(.debug_info) }
    .debug_abbrev   0 : { *(.debug_abbrev) }
    .debug_line     0 : { *(.debug_line) }
    .debug_frame    0 : { *(.debug_frame) }
    .debug_str      0 : { *(.debug_str) }
    .debug_loc      0 : { *(.debug_loc) }
    .debug_macinfo  0 : { *(.debug_macinfo) }

    /* Discard everything not specifically mentioned above. */
    /DISCARD/ :
    {
        *(*);
    }
}
